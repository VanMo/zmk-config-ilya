#include "includes/behaviors.dtsi"
#include "includes/keys.h"
#include "includes/layers.h"
#include "zmk-helpers/key-labels/totem.h"

/*
      ╭─────────────────────┬─────────────────────╮
      │ LT4 LT3 LT2 LT1 LT0 │ RT0 RT1 RT2 RT3 RT4 │
  ╭───╯ LM4 LM3 LM2 LM1 LM0 │ RM0 RM1 RM2 RM3 RM4 ╰───╮
  │ LB5 LB4 LB3 LB2 LB1 LB0 │ RB0 RB1 RB2 RB3 RB4 RB5 │
  ╰───────────╮ LH2 LH1 LH0 │ RH0 RH1 RH2 ╭───────────╯
              ╰─────────────┴─────────────╯
*/

MAKE_HRM(hml,   &kp, &kp,   KEYS_R THUMBS)
MAKE_HRM(hml_h, &kp, &none, KEYS_R THUMBS)
MAKE_HRM(hmr,   &kp, &kp,   KEYS_L THUMBS)
MAKE_HRM(hmr_h, &kp, &none, KEYS_L THUMBS)

ZMK_SMART_TOGGLE(tabber,
    bindings = <&kp LCTRL>, <&kp TAB>;
    ignored-key-positions = <LT1 LT2>;
)

ZMK_SMART_TOGGLE(swapper,
    bindings = <&kp LGUI>, <&kp TAB>;
    ignored-key-positions = <LB1 LB2>;
)

ZMK_MACRO(double_ctrl,
    bindings = <&macro_tap>,
               <&kp LCTRL>,
               <&macro_tap>,
               <&kp LCTRL>;
)

ZMK_MACRO(double_shft,
    bindings = <&macro_tap>,
               <&kp LSHFT>,
               <&macro_tap>,
               <&kp LSHFT>;
)

ZMK_MACRO(double_gui,
    bindings = <&macro_tap>,
               <&kp LGUI>,
               <&macro_tap>,
               <&kp LGUI>;
)

ZMK_COMBO(para_left,      &kp UL_LPAR,    LT1 LT0,    DEF SYM,  COMBO_TERM, COMBO_IDLE)
ZMK_COMBO(para_right,     &kp UL_RPAR,    RT0 RT1,    DEF SYM,  COMBO_TERM, COMBO_IDLE)
ZMK_COMBO(brak_left,      &kp UL_LBKT,    LM1 LM0,    DEF SYM,  COMBO_TERM, COMBO_IDLE)
ZMK_COMBO(brak_right,     &kp UL_RBKT,    RM0 RM1,    DEF SYM,  COMBO_TERM, COMBO_IDLE)
ZMK_COMBO(brace_left,     &kp UL_LBRC,    LB1 LB0,    DEF SYM,  COMBO_TERM, COMBO_IDLE)
ZMK_COMBO(brace_right,    &kp UL_RBRC,    RB0 RB1,    DEF SYM,  COMBO_TERM, COMBO_IDLE)
ZMK_COMBO(single_quote,   &kp UL_SQT,     LB2 LB1,    DEF SYM,  COMBO_TERM, COMBO_IDLE)
ZMK_COMBO(double_quote,   &kp UL_DQT,     RB1 RB2,    DEF SYM,  COMBO_TERM, COMBO_IDLE)
ZMK_COMBO(grave,          &kp UL_GRAVE,   LT2 LT1,    DEF SYM,  COMBO_TERM, COMBO_IDLE)
ZMK_COMBO(tilde,          &kp UL_TILDE,   RT1 RT2,    DEF SYM,  COMBO_TERM, COMBO_IDLE)
ZMK_COMBO(backslash,      &kp UL_BSLH,    LM3 LM2,    DEF SYM,  COMBO_TERM, COMBO_IDLE)
ZMK_COMBO(slash,          &kp UL_FSLH,    RM2 RM3,    DEF SYM,  COMBO_TERM, COMBO_IDLE)
ZMK_COMBO(arrow,          &kp LS(LA(K)),  LT3 LT2,    DEF SYM,  COMBO_TERM, COMBO_IDLE)
ZMK_COMBO(double_arrow,   &kp LA(K),      RT2 RT3,    DEF SYM,  COMBO_TERM, COMBO_IDLE)
ZMK_COMBO(lang_ru,        &kp LG(F11),    LM2 LM1,    DEF SYM,  COMBO_TERM, COMBO_IDLE)
ZMK_COMBO(lang_en,        &kp LG(F12),    RM1 RM2,    DEF SYM,  COMBO_TERM, COMBO_IDLE)
//ZMK_COMBO(layer_game,     &tog GAM,       RT3 RT4,    DEF,      COMBO_TERM, COMBO_IDLE)
//ZMK_COMBO(esc,            &kp ESC,        LT3 LT4,    DEF SYM,  COMBO_TERM, COMBO_IDLE)
//ZMK_COMBO(tab,            &kp TAB,        LM3 LM4,    DEF SYM,  COMBO_TERM, COMBO_IDLE)

ZMK_CONDITIONAL_LAYER(fn_layer, NAV SYM, FN)
ZMK_CONDITIONAL_LAYER(adj_layer, NAV EXT, ADJ)

/**
 * Default Layer - QWERTY
 */
ZMK_LAYER(base,
//           ╭───────────────┬───────────────┬───────────────┬───────────────┬───────────────╮   ╭───────────────┬───────────────┬───────────────┬───────────────┬───────────────╮
//           │           Q Й │           W Ц │           E У │           R К │           T Е │   │           Y Н │           U Г │           I Ш │           O З │           P Х │
              _ Q             _ W             _ E             _ R             _ T                 _ Y             _ U             _ I             _ O             _ P
//           ├───────────────┼───────────────┼───────────────┼───────────────┼───────────────┤   ├───────────────┼───────────────┼───────────────┼───────────────┼───────────────┤
//           │ GUI       A Ф │ ALT       S Ы │ CTRL      D В │ SHIFT     F А │           G П │   │           H Р │ SHIFT     J О │ CTRL      K Л │ ALT       L Д │ GUI       ~ Ж │
              &hml LGUI A     &hml LALT S     &hml LCTRL D    &hml LSHFT F    _ G                 _ H             &hmr LSHFT J    &hmr LCTRL K    &hmr LALT L     &hmr LGUI UL_TILDE
// ╭─────────┼───────────────┼───────────────┼───────────────┼───────────────┼───────────────┤   ├───────────────┼───────────────┼───────────────┼───────────────┼───────────────┼─────────╮
// │         │           Z Я │           X Ч │           C С │           V М │           B И │   │           N Т │           M Ь │           & Б │           [ Ю │           ] Э │       / │
    _ LCTRL   _ Z             _ X             _ C             _ V             _ B                 _ N             _ M             _ UL_AMPS       _ UL_LBKT       _ UL_RBKT       _ UL_FSLH
// ╰─────────┴───────────────┴───────────────┼───────────────┼───────────────┼───────────────┤   ├───────────────┼───────────────┼───────────────┼───────────────┴───────────────┴─────────╯
//                                           │               │               │               │   │               │               │               │
                                              _ LGUI          _ LSHFT         &lt NAV SPACE       &lt SYM ENTER   &lt EXT BSPC    _ DEL
//                                           ╰───────────────┴───────────────┴───────────────╯   ╰───────────────┴───────────────┴───────────────╯
)

/**
 * SYM Layer
 */
ZMK_LAYER(symbol,
//           ╭──────────────────┬──────────────────┬──────────────────┬──────────────────┬───────────────╮   ╭───────────────┬──────────────────┬──────────────────┬──────────────────┬──────────────────╮
//           │                ^ │                @ │                # │                $ │             ( │   │             ) │                ? │                ! │                * │                % │
              _ UL_CARET         _ UL_AT            _ UL_HASH          _ UL_DLLR          _ UL_LPAR           _ UL_RPAR       _ UL_QSTM          _ UL_EXCL          _ UL_ASTRK         _ UL_PRCNT
//           ├──────────────────┼──────────────────┼──────────────────┼──────────────────┼───────────────┤   ├───────────────┼──────────────────┼──────────────────┼──────────────────┼──────────────────┤
//           │ GUI          ~ Ж │ ALT            ` │ CTRL           ' │ SHIFT          " │             [ │   │             ] │ SHIFT          . │ CTRL           : │ ALT            + │ GUI            = │
              &hml LGUI UL_TILDE &hml LALT UL_GRAVE &hml LCTRL UL_SQT  &hml LSHFT UL_DQT  _ LA(UL_LBKT)       _ LA(UL_RBKT)   &hmr LSHFT UL_DOT  &hmr LCTRL LS(UL_DOT) &hmr LALT PLUS  &hmr LGUI EQUAL
// ╭─────────┼──────────────────┼──────────────────┼──────────────────┼──────────────────┼───────────────┤   ├───────────────┼──────────────────┼──────────────────┼──────────────────┼──────────────────┼─────────╮
// │         │               -> │                | │                \ │                / │             { │   │             } │                , │                ; │                - │                _ │         │
    ___       _ LS(LA(K))        _ UL_PIPE          _ UL_BSLH          _ UL_FSLH          _ LA(UL_LBRC)       _ LA(UL_RBRC)   _ UL_COMMA         _ LS(UL_COMMA)     _ MINUS            _ UNDER            XXX
// ╰─────────┴──────────────────┴──────────────────┼──────────────────┼──────────────────┼───────────────┤   ├───────────────┼──────────────────┼──────────────────┼──────────────────┴──────────────────┴─────────╯
//                                                 │                  │                  │               │   │               │                  │                  │
                                                    ___                ___                ___                 ___             ___                ___
//                                                 ╰──────────────────┴──────────────────┴───────────────╯   ╰───────────────┴──────────────────┴──────────────────╯
)

/**
 * NAV Layer
 */
ZMK_LAYER(nav,
//           ╭──────────────────┬──────────────────┬──────────────────┬──────────────────┬───────────────╮   ╭───────────────┬──────────────────┬──────────────────┬──────────────────┬───────────────╮
              _ UL_COMMA         _ UL_N7            _ UL_N8            _ UL_N9            _ ESC               XXX             _ PG_UP            XXX                _ PG_DN            &tog GAM
//           ├──────────────────┼──────────────────┼──────────────────┼──────────────────┼───────────────┤   ├───────────────┼──────────────────┼──────────────────┼──────────────────┼───────────────┤
              &hml LGUI UL_DOT   &hml LALT UL_N4    &hml LCTRL UL_N5   &hml LSHFT UL_N6   _ TAB               _ DEL           &hmr LSHFT LEFT    &hmr LCTRL UP      &hmr LALT RIGHT    &hmr_h LGUI 0
// ╭─────────┼──────────────────┼──────────────────┼──────────────────┼──────────────────┼───────────────┤   ├───────────────┼──────────────────┼──────────────────┼──────────────────┼───────────────┼─────────╮
    ___       _ UL_N0            _ UL_N1            _ UL_N2            _ UL_N3            _ ENTER             &caps_word      _ HOME             _ DOWN             _ END              XXX             XXX
// ╰─────────┴──────────────────┴──────────────────┼──────────────────┼──────────────────┼───────────────┤   ├───────────────┼──────────────────┼──────────────────┼──────────────────┴───────────────┴─────────╯
                                                    ___                ___                ___                 ___             ___                ___
//                                                 ╰──────────────────┴──────────────────┴───────────────╯   ╰───────────────┴──────────────────┴──────────────────╯
)

/**
 * EXT Layer
 */
ZMK_LAYER(ext,
//           ╭───────────────┬───────────────┬───────────────┬───────────────┬───────────────╮   ╭───────────────┬───────────────┬───────────────┬───────────────┬───────────────╮
              XXX             XXX             &swapper        &tabber         _ ESC               _ C_VOL_UP      XXX             XXX             XXX             _ C_BRI_UP
//           ├───────────────┼───────────────┼───────────────┼───────────────┼───────────────┤   ├───────────────┼───────────────┼───────────────┼───────────────┼───────────────┤
              XXX             _ SPACE_D       _ SPACE_P       _ SPACE_N       _ SPACE_U           _ C_VOL_DN      _ C_PP          _ C_PREV        _ C_NEXT        _ C_BRI_DN
// ╭─────────┼───────────────┼───────────────┼───────────────┼───────────────┼───────────────┤   ├───────────────┼───────────────┼───────────────┼───────────────┼───────────────┼─────────╮
    ___       &double_ctrl    &double_shft    &double_gui     XXX             XXX                 _ C_MUTE        XXX             XXX             XXX             XXX             XXX
// ╰─────────┴───────────────┴───────────────┼───────────────┼───────────────┼───────────────┤   ├───────────────┼───────────────┼───────────────┼───────────────┴───────────────┴─────────╯
                                              ___             ___             ___                 ___             ___             ___
//                                           ╰───────────────┴───────────────┴───────────────╯   ╰───────────────┴───────────────┴───────────────╯
)

/**
 * GAM Layer
 */
ZMK_LAYER(game,
//           ╭───────────────┬───────────────┬───────────────┬───────────────┬───────────────╮   ╭───────────────┬───────────────┬───────────────┬───────────────┬───────────────╮
              _ ESC           _ Q             _ W             _ E             _ R                 _ C_VOL_UP      XXX             XXX             XXX             &tog GAM
//           ├───────────────┼───────────────┼───────────────┼───────────────┼───────────────┤   ├───────────────┼───────────────┼───────────────┼───────────────┼───────────────┤
              _ TAB           _ A             _ S             _ D             _ F                 _ C_VOL_DN      _ LEFT          _ UP            _ RIGHT         XXX
// ╭─────────┼───────────────┼───────────────┼───────────────┼───────────────┼───────────────┤   ├───────────────┼───────────────┼───────────────┼───────────────┼───────────────┼─────────╮
    _ LCTRL   _ LCTRL         _ Z             _ X             _ C             _ V                 _ C_MUTE        XXX             _ DOWN          XXX             XXX             XXX
// ╰─────────┴───────────────┴───────────────┼───────────────┼───────────────┼───────────────┤   ├───────────────┼───────────────┼───────────────┼───────────────┴───────────────┴─────────╯
                                              &mo GFN         _ LSHFT         _ SPACE             _ ENTER         _ BSPC          _ LALT
//                                           ╰───────────────┴───────────────┴───────────────╯   ╰───────────────┴───────────────┴───────────────╯
)

/**
 * GFN Layer
 */
ZMK_LAYER(gamefn,
//           ╭───────────────┬───────────────┬───────────────┬───────────────┬───────────────╮   ╭───────────────┬───────────────┬───────────────┬───────────────┬───────────────╮
              _ M             _ UL_N7         _ UL_N8         _ UL_N9         _ T                 _ Y             _ U             _ I             _ O             _ P
//           ├───────────────┼───────────────┼───────────────┼───────────────┼───────────────┤   ├───────────────┼───────────────┼───────────────┼───────────────┼───────────────┤
              _ I             _ UL_N4         _ UL_N5         _ UL_N6         _ G                 _ H             _ J             _ K             _ L             XXX
// ╭─────────┼───────────────┼───────────────┼───────────────┼───────────────┼───────────────┤   ├───────────────┼───────────────┼───────────────┼───────────────┼───────────────┼─────────╮
    ___       _ UL_N0         _ UL_N1         _ UL_N2         _ UL_N3         _ B                 _ N             _ M             XXX             XXX             XXX             XXX
// ╰─────────┴───────────────┴───────────────┼───────────────┼───────────────┼───────────────┤   ├───────────────┼───────────────┼───────────────┼───────────────┴───────────────┴─────────╯
                                              ___             _ LALT          _ ENTER             ___             ___             ___
//                                           ╰───────────────┴───────────────┴───────────────╯   ╰───────────────┴───────────────┴───────────────╯
)

/**
 * Fn Layer
 */
ZMK_LAYER(fn,
//          ╭───────────────┬───────────────┬───────────────┬───────────────┬───────────────╮   ╭───────────────┬───────────────┬───────────────┬───────────────┬───────────────╮
             _ KP_COMMA      _ KP_N7         _ KP_N8         _ KP_N9         XXX                 _ F10           _ F9            _ F8            _ F7            _ F13
//          ├───────────────┼───────────────┼───────────────┼───────────────┼───────────────┤   ├───────────────┼───────────────┼───────────────┼───────────────┼───────────────┤
             &hml LGUI KP_DOT &hml LALT KP_N4 &hml LCTRL KP_N5 &hml LSHFT KP_N6 XXX               _ F11           &hmr LSHFT F6   &hmr LCTRL F5   &hmr LALT F4    &hmr LGUI F14
// ╭────────┼───────────────┼───────────────┼───────────────┼───────────────┼───────────────┤   ├───────────────┼───────────────┼───────────────┼───────────────┼───────────────┼─────────╮
    XXX      _ KP_N0         _ KP_N1         _ KP_N2         _ KP_N3         XXX                 _ F12           _ F3            _ F2            _ F1            _ F15         XXX
// ╰────────┴───────────────┴───────────────┼───────────────┼───────────────┼───────────────┤   ├───────────────┼───────────────┼───────────────┼───────────────┴───────────────┴─────────╯
                                             ___             ___             ___                 ___             ___             ___
//                                          ╰───────────────┴───────────────┴───────────────╯   ╰───────────────┴───────────────┴───────────────╯
)

/**
 * ADJ Layer
 */
ZMK_LAYER(adjust,
//           ╭───────────────┬───────────────┬───────────────┬───────────────┬───────────────╮   ╭───────────────┬───────────────┬───────────────┬───────────────┬───────────────╮
              &bootloader     XXX             &sys_reset      XXX             &out OUT_TOG        &out OUT_TOG    XXX             &sys_reset      XXX             &bootloader
//           ├───────────────┼───────────────┼───────────────┼───────────────┼───────────────┤   ├───────────────┼───────────────┼───────────────┼───────────────┼───────────────┤
              &bt BT_SEL 0    &bt BT_SEL 1    &bt BT_SEL 2    &bt BT_SEL 3    &bt BT_SEL 4        &bt BT_SEL 4    &bt BT_SEL 3    &bt BT_SEL 2    &bt BT_SEL 1    &bt BT_SEL 0
// ╭─────────┼───────────────┼───────────────┼───────────────┼───────────────┼───────────────┤   ├───────────────┼───────────────┼───────────────┼───────────────┼───────────────┼─────────╮
    XXX       XXX             XXX             XXX             XXX             &bt BT_CLR          &bt BT_CLR      XXX             XXX             XXX             XXX             XXX
// ╰─────────┴───────────────┴───────────────┼───────────────┼───────────────┼───────────────┤   ├───────────────┼───────────────┼───────────────┼───────────────┴───────────────┴─────────╯
                                              ___             ___             ___                 ___             ___             ___
//                                           ╰───────────────┴───────────────┴───────────────╯   ╰───────────────┴───────────────┴───────────────╯
)
